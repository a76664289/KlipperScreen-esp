## src/ports/esp32/sdkconfig.defaults.ESP32-3248S035C
```kconfig
# 板型：ESP32-3248S035C（ESP32，3.5" 320x480 ST7796 SPI + GT911）
CONFIG_IDF_TARGET="esp32"
CONFIG_BOARD_ESP32_3248S035C=y

# Flash 4MB 80MHz QIO
CONFIG_ESPTOOLPY_FLASHMODE_QIO=y
CONFIG_ESPTOOLPY_FLASHFREQ_80M=y
CONFIG_ESPTOOLPY_FLASHSIZE_4MB=y
CONFIG_ESPTOOLPY_FLASHSIZE="4MB"

# CPU 240MHz
CONFIG_ESP32_DEFAULT_CPU_FREQ_240=y

# 无 PSRAM（ESP32 经典版内部 SRAM 足够）
# CONFIG_SPIRAM is not set

# 分区表
CONFIG_PARTITION_TABLE_CUSTOM_FILENAME="partitions_esp32_3248s035c.csv"
CONFIG_PARTITION_TABLE_FILENAME="partitions_esp32_3248s035c.csv"

# 编译优化：-Og（和 e32r35t、esp32-ST7796-320_240-ec11 一致）
# 4MB Flash 空间紧张，-Og 体积最小最稳
CONFIG_COMPILER_OPTIMIZATION_DEBUG=y
# CONFIG_COMPILER_OPTIMIZATION_SIZE is not set
# CONFIG_COMPILER_OPTIMIZATION_PERF is not set

# LVGL 刷新周期
CONFIG_LV_DEF_REFR_PERIOD=33

# 关闭旋转编码器（3248S035C 没编码器，GPIO27 是背光，会冲突）
# CONFIG_INPUT_ROTARY_ENCODER is not set

# 字体（ui_layout.c 用到 14/24/28/48）
CONFIG_LV_FONT_MONTSERRAT_12=y
CONFIG_LV_FONT_MONTSERRAT_14=y
CONFIG_LV_FONT_MONTSERRAT_16=y
# CONFIG_LV_FONT_MONTSERRAT_18 is not set
# CONFIG_LV_FONT_MONTSERRAT_20 is not set
# CONFIG_LV_FONT_MONTSERRAT_22 is not set
CONFIG_LV_FONT_MONTSERRAT_24=y
# CONFIG_LV_FONT_MONTSERRAT_26 is not set
CONFIG_LV_FONT_MONTSERRAT_28=y
# CONFIG_LV_FONT_MONTSERRAT_30 is not set
CONFIG_LV_FONT_MONTSERRAT_32=y
# CONFIG_LV_FONT_MONTSERRAT_34 is not set
# CONFIG_LV_FONT_MONTSERRAT_36 is not set
# CONFIG_LV_FONT_MONTSERRAT_38 is not set
# CONFIG_LV_FONT_MONTSERRAT_40 is not set
# CONFIG_LV_FONT_MONTSERRAT_42 is not set
# CONFIG_LV_FONT_MONTSERRAT_44 is not set
# CONFIG_LV_FONT_MONTSERRAT_46 is not set
CONFIG_LV_FONT_MONTSERRAT_48=y
CONFIG_LV_FONT_DEFAULT_MONTSERRAT_14=y
CONFIG_LV_FONT_FMT_TXT_LARGE=y
CONFIG_LV_USE_FONT_COMPRESSED=y
```

## src/ports/esp32/sdkconfig.defaults.JC4827W543C
```kconfig
# ===== 目标芯片 =====
CONFIG_IDF_TARGET="esp32s3"
# 板型：JC4827W543C（ESP32-S3，4.3" 480x272 QSPI NV3041A + GT911 电容触摸）
CONFIG_BOARD_JC4827W543C=y

# ESP32-S3：Flash 4MB 80MHz QIO，Octal PSRAM 80MHz
# QSPI 屏全帧缓冲（480x272x2B = 261KB）必须放 PSRAM
CONFIG_ESPTOOLPY_FLASHMODE_QIO=y
CONFIG_ESPTOOLPY_FLASHFREQ_80M=y
CONFIG_ESPTOOLPY_FLASHSIZE_4MB=y
CONFIG_ESPTOOLPY_FLASHSIZE="4MB"
CONFIG_ESP32S3_DEFAULT_CPU_FREQ_240=y
CONFIG_SPIRAM=y
CONFIG_SPIRAM_MODE_OCT=y
CONFIG_SPIRAM_SPEED_80M=y
CONFIG_SPIRAM_USE_MALLOC=y
CONFIG_SPIRAM_MALLOC_ALWAYSINTERNAL=16384

# 不开 XIP：让代码取指走 Flash，避免与 PSRAM 里的 framebuffer 争抢 MSPI
# CONFIG_SPIRAM_XIP_FROM_PSRAM is not set

# 4MB flash 专用分区表（factory 3MB，storage 960KB）
CONFIG_PARTITION_TABLE_CUSTOM_FILENAME="partitions_JC4827W543C.csv"
CONFIG_PARTITION_TABLE_FILENAME="partitions_JC4827W543C.csv"

# LVGL 渲染周期 15ms
CONFIG_LV_DEF_REFR_PERIOD=15

# -O2：和 jc8048w550 一致，避免 -Og 下滑动整页渲染超帧预算
# 4MB flash 下体积压力大，如果 app 溢出可改回 CONFIG_COMPILER_OPTIMIZATION_SIZE=y
CONFIG_COMPILER_OPTIMIZATION_PERF=y

# 关闭旋转编码器
# CONFIG_INPUT_ROTARY_ENCODER is not set

# ===== 字库裁剪（4MB flash 必须精简）=====
# 只保留常用字号，去掉不必要的大字号
CONFIG_LV_FONT_MONTSERRAT_12=y
CONFIG_LV_FONT_MONTSERRAT_14=y
CONFIG_LV_FONT_MONTSERRAT_16=y
# CONFIG_LV_FONT_MONTSERRAT_18 is not set
# CONFIG_LV_FONT_MONTSERRAT_20 is not set
# CONFIG_LV_FONT_MONTSERRAT_22 is not set
CONFIG_LV_FONT_MONTSERRAT_24=y
# CONFIG_LV_FONT_MONTSERRAT_26 is not set
CONFIG_LV_FONT_MONTSERRAT_28=y
# CONFIG_LV_FONT_MONTSERRAT_30 is not set
CONFIG_LV_FONT_MONTSERRAT_32=y
# CONFIG_LV_FONT_MONTSERRAT_34 is not set
# CONFIG_LV_FONT_MONTSERRAT_36 is not set
# CONFIG_LV_FONT_MONTSERRAT_38 is not set
# CONFIG_LV_FONT_MONTSERRAT_40 is not set
# CONFIG_LV_FONT_MONTSERRAT_42 is not set
# CONFIG_LV_FONT_MONTSERRAT_44 is not set
# CONFIG_LV_FONT_MONTSERRAT_46 is not set
# CONFIG_LV_FONT_MONTSERRAT_48 is not set
CONFIG_LV_FONT_MONTSERRAT_48=y
CONFIG_LV_FONT_DEFAULT_MONTSERRAT_14=y

# 中文字库：用压缩（LV_FONT_FMT_TXT_LARGE 打开），4MB 下必须这样做
# 如果掉帧严重，考虑把字库放 littlefs 并 mmap 加载
CONFIG_LV_FONT_FMT_TXT_LARGE=y
CONFIG_LV_USE_FONT_COMPRESSED=y
```
